## isar-yocto-hybrid-demo/meta-hybrid-demo/conf/layer.conf
```bitbake
# Minimal layer configuration for the hybrid demo
BBPATH .= ":${LAYERDIR}"

BBFILE_COLLECTIONS += "meta-hybrid-demo"
BBFILE_PATTERN_meta-hybrid-demo = "^${LAYERDIR}/"
BBFILE_PRIORITY_meta-hybrid-demo = "7"

LAYERSERIES_COMPAT_meta-hybrid-demo = "langdale"

BBFILES += " \
  ${LAYERDIR}/recipes-*/*/*.bbappend \
  ${LAYERDIR}/recipes-*/*/*.inc \
  ${LAYERDIR}/recipes-*/*/*.bb \
"
```
